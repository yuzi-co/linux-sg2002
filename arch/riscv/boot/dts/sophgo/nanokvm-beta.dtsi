// SPDX-License-Identifier: (GPL-2.0 OR MIT)
/*
 * NanoKVM beta, the reference board: LT6911UXC on I2C4, the OLED at 0x3d
 * on the bit-banged bus 5. The pcie board's OLED is at 0x3c on the same
 * bus, and Sipeed's variant probe tells beta from pcie by that address
 * (trial 12: i2cdetect -q on bus 5 finds 0x3d only).
 */

#include "nanokvm-beta-pcie.dtsi"

/ {
	model = "Sipeed NanoKVM beta";
	compatible = "sipeed,nanokvm-beta", "sipeed,licheerv-nano-b",
		     "sipeed,licheerv-nano", "sophgo,sg2002";
};
