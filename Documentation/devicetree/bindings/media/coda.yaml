## drivers/media/platform/chips-media/wave420l/Kconfig
```kconfig
# SPDX-License-Identifier: GPL-2.0-only
config VIDEO_WAVE420L
	tristate "Chips&Media WAVE420L H.265 encoder for the Sophgo SG2002"
	depends on V4L_MEM2MEM_DRIVERS
	depends on VIDEO_DEV && OF && HAS_DMA
	depends on ARCH_SOPHGO || COMPILE_TEST
	select VIDEOBUF2_DMA_CONTIG
	select V4L2_MEM2MEM_DEV
	select VIDEO_SG2002_VC_SRAM
	help
	  A V4L2 mem2mem driver for the WAVE420L H.265 encoder core of the
	  Sophgo SG2002: NV12 or NV21 in, HEVC Main profile out. It needs
	  the core's firmware, monet.bin, which is not redistributable and
	  is not part of linux-firmware.

	  To compile this driver as a module, choose M here: the module
	  will be called wave420l.
```

## drivers/media/platform/sophgo/Kconfig
```kconfig
# SPDX-License-Identifier: GPL-2.0-only

config VIDEO_SOPHGO_SG2002_CSI
	tristate "Sophgo SG2002 CSI-2 capture"
	depends on ARCH_SOPHGO || COMPILE_TEST
	depends on V4L_PLATFORM_DRIVERS
	depends on VIDEO_DEV
	depends on OF
	select MEDIA_CONTROLLER
	select MFD_SYSCON
	select VIDEO_V4L2_SUBDEV_API
	select VIDEOBUF2_DMA_CONTIG
	select V4L2_FWNODE
	help
	  Support the CSI-2 receiver and direct-to-memory video input path in
	  the Sophgo SG2002/CV181x video subsystem. The initial implementation
	  supports one four-lane YUV422 input on CSI MAC0 and exposes it as a
	  V4L2 capture device.

config VIDEO_SOPHGO_SG2002_VPSS
	tristate "Sophgo SG2002 VPSS scaler/CSC mem2mem"
	depends on V4L_MEM2MEM_DRIVERS
	depends on VIDEO_DEV
	depends on OF
	depends on ARCH_SOPHGO || COMPILE_TEST
	select VIDEOBUF2_DMA_CONTIG
	select V4L2_MEM2MEM_DEV
	help
	  Support the VIP scaler/CSC block ("VPSS") in the Sophgo SG2002/CV181x
	  video subsystem as a memory-to-memory device: packed or semiplanar

config VIDEO_SOPHGO_SG2002_VIDEO_CLK
	bool "Sophgo SG2002 video clock profile"
	depends on ARCH_SOPHGO || COMPILE_TEST
	depends on COMMON_CLK
	depends on OF
	default ARCH_SOPHGO
	help
	  Choose the rates of the SG2002's codec core, VPSS and codec bus
	  clocks at run time, through the sg2002_video_clk.profile parameter:
	  standard (396, 300 and 360 MHz) or fast (594, 396 and 450 MHz). A
	  clock changes only while no block uses it, so the choice takes
	  effect when the video next starts.
```
