## Documentation/devicetree/bindings/media/coda.yaml
```yaml
# SPDX-License-Identifier: (GPL-2.0 OR BSD-2-Clause)
%YAML 1.2
---
$id: http://devicetree.org/schemas/media/coda.yaml#
$schema: http://devicetree.org/meta-schemas/core.yaml#

title: Chips&Media Coda multi-standard codec IP

maintainers:
  - Philipp Zabel <p.zabel@pengutronix.de>

description: |-
  Coda codec IPs are present in i.MX SoCs in various versions, called VPU
  (Video Processing Unit). The Sophgo SG2002 integrates a Coda980 H.264 core
  with a separate video-codec control window.

properties:
  compatible:
    oneOf:
      - items:
          - const: fsl,imx27-vpu
          - const: cnm,codadx6
      - items:
          - const: fsl,imx51-vpu
          - const: cnm,codahx4
      - items:
          - const: fsl,imx53-vpu
          - const: cnm,coda7541
      - items:
          - enum:
              - fsl,imx6dl-vpu
              - fsl,imx6q-vpu
          - const: cnm,coda960
      - const: sophgo,sg2002-coda980

  reg:
    true

  reg-names:
    true

  clocks:
    true

  clock-names:
    true

  interrupts:
    true

  interrupt-names:
    true

  power-domains:
    maxItems: 1

  resets:
    maxItems: 1

  iram:
    $ref: /schemas/types.yaml#/definitions/phandle
    description: phandle pointing to the SRAM device node

  firmware-name:
    $ref: /schemas/types.yaml#/definitions/string
    description: Firmware image loaded into the Coda processor.

required:
  - compatible
  - reg
  - interrupts
  - clocks
  - clock-names

additionalProperties: false

allOf:
  - if: # i.MX Coda960 has a separate JPEG interrupt
      properties:
        compatible:
          contains:
            const: cnm,coda960
    then:
      properties:
        interrupts:
          minItems: 2

        interrupt-names:
          minItems: 2
    else:
      properties:
        interrupts:
          maxItems: 1

        power-domains: false

  - if:
      properties:
        compatible:
          contains:
            const: sophgo,sg2002-coda980
    then:
      properties:
        reg:
          minItems: 2
          maxItems: 2
        reg-names:
          items:
            - const: vc-ctrl
            - const: h264
        clocks:
          minItems: 5
          maxItems: 5
        clock-names:
          items:
            - const: axi-video-codec
            - const: cfg-reg-vc
            - const: vc-src0
            - const: h264c
            - const: apb-h264c
        interrupts:
          maxItems: 1
        interrupt-names:
          items:
            - const: h264
        resets:
          maxItems: 1
      required:
        - reg-names
        - firmware-name
        - resets
    else:
      properties:
        reg:
          maxItems: 1
        reg-names: false
        firmware-name: false
        clocks:
          items:
            - description: PER clock
            - description: AHB interface clock
        clock-names:
          items:
            - const: per
            - const: ahb
        interrupts:
          minItems: 1
          items:
            - description: BIT processor interrupt
            - description: JPEG unit interrupt
        interrupt-names:
          minItems: 1
          items:
            - const: bit
            - const: jpeg

examples:
  - |
    vpu: video-codec@63ff4000 {
        compatible = "fsl,imx53-vpu", "cnm,coda7541";
        reg = <0x63ff4000 0x1000>;
        interrupts = <9>;
        clocks = <&clks 63>, <&clks 63>;
        clock-names = "per", "ahb";
        iram = <&ocram>;
    };

  - |
    #include <dt-bindings/clock/sophgo,cv1800.h>
    #include <dt-bindings/interrupt-controller/irq.h>

    vcodec: video-codec@b030000 {
        compatible = "sophgo,sg2002-coda980";
        reg = <0x0b030000 0x100>, <0x0b010000 0x10000>;
        reg-names = "vc-ctrl", "h264";
        interrupts = <21 IRQ_TYPE_LEVEL_HIGH>;
        interrupt-names = "h264";
        clocks = <&clk CLK_AXI_VIDEO_CODEC>,
                 <&clk CLK_CFG_REG_VC>,
                 <&clk CLK_VC_SRC0>,
                 <&clk CLK_H264C>,
                 <&clk CLK_APB_H264C>;
        clock-names = "axi-video-codec", "cfg-reg-vc", "vc-src0",
                      "h264c", "apb-h264c";
        resets = <&rst RST_H264C>;
        firmware-name = "sophgo/sg2002/coda980.bin";
    };
```

## Documentation/devicetree/bindings/media/sophgo,sg2002-csi-capture.yaml
```yaml
# SPDX-License-Identifier: (GPL-2.0-only OR BSD-2-Clause)
%YAML 1.2
---
$id: http://devicetree.org/schemas/media/sophgo,sg2002-csi-capture.yaml#
$schema: http://devicetree.org/meta-schemas/core.yaml#

title: Sophgo SG2002 CSI-2 capture

maintainers:
  - George Whewell <georgerw@gmail.com>

description:
  The SG2002 CSI-2 capture block combines the CSI MAC, CSI wrapper, VI
  bridge, and VIP system control registers into one capture device. It
  accepts one CSI-2 D-PHY input and exposes the VI DMA capture path.

properties:
  compatible:
    const: sophgo,sg2002-csi-capture

  reg:
    items:
      - description: CSI MAC0 registers
      - description: CSI wrapper registers
      - description: VI registers
      - description: VIP system registers

  reg-names:
    items:
      - const: csi-mac0
      - const: csi-wrap
      - const: vi
      - const: vip-sys

  interrupts:
    items:
      - description: VI capture interrupt
      - description: CSI MAC interrupt

  interrupt-names:
    items:
      - const: vi
      - const: csi

  clocks:
    items:
      - description: VIP system clock 0
      - description: VIP system clock 1
      - description: VIP system clock 2
      - description: VIP system clock 3
      - description: VIP AXI clock
      - description: VIP register configuration clock
      - description: VIP IP clock 0
      - description: VIP IP clock 1
      - description: VIP IP clock 2
      - description: VIP IP clock 3
      - description: CSI back-end clock
      - description: VIP raw clock
      - description: VIP ISP top clock
      - description: CSI MAC0 clock
      - description: CSI0 receiver clock

  clock-names:
    items:
      - const: vip-sys0
      - const: vip-sys1
      - const: vip-sys2
      - const: vip-sys3
      - const: axi
      - const: cfg-reg
      - const: vip-ip0
      - const: vip-ip1
      - const: vip-ip2
      - const: vip-ip3
      - const: csi-be
      - const: raw
      - const: isp-top
      - const: csi-mac0
      - const: csi0-rx

  resets:
    items:
      - description: CSI D-PHY reset
      - description: CSI D-PHY APB reset

  reset-names:
    items:
      - const: csi-phy
      - const: csi-phy-apb

  sophgo,ddr-top:
    $ref: /schemas/types.yaml#/definitions/phandle
    description: Phandle to the DDR top syscon.

  port:
    $ref: /schemas/graph.yaml#/$defs/port-base
    unevaluatedProperties: false
    description: CSI-2 D-PHY input port.

    properties:
      endpoint:
        $ref: video-interfaces.yaml#
        unevaluatedProperties: false

        properties:
          bus-type:
            const: 4

          clock-lanes:
            $ref: /schemas/types.yaml#/definitions/uint32
            maximum: 5

          data-lanes:
            minItems: 4
            maxItems: 4
            uniqueItems: true
            items:
              maximum: 5

          remote-endpoint:
            $ref: /schemas/types.yaml#/definitions/phandle

    required:
      - endpoint

required:
  - compatible
  - reg
  - reg-names
  - interrupts
  - interrupt-names
  - clocks
  - clock-names
  - resets
  - reset-names
  - sophgo,ddr-top
  - port

additionalProperties: false

examples:
  - |
    #define RST_CSI_PHY0 70
    #define RST_CSI_PHY0_APB 71

    / {
        #address-cells = <1>;
        #size-cells = <1>;

        clk: clock-controller {
            #clock-cells = <1>;
        };

        rst: reset-controller {
            #reset-cells = <1>;
        };

        plic: interrupt-controller {
            interrupt-controller;
            #interrupt-cells = <1>;
        };

        ddr_top: syscon@800a000 {
            compatible = "sophgo,sg2002-ddr-top", "syscon";
            reg = <0x0800a000 0x1000>;
        };

        csi@a0c2000 {
            compatible = "sophgo,sg2002-csi-capture";
            reg = <0x0a0c2000 0x2000>,
                  <0x0a0d0000 0x1000>,
                  <0x0a000000 0x80000>,
                  <0x0a0c8000 0x2000>;
            reg-names = "csi-mac0", "csi-wrap", "vi", "vip-sys";
            interrupt-parent = <&plic>;
            interrupts = <12>, <13>;
            interrupt-names = "vi", "csi";
            clocks = <&clk 100>, <&clk 101>, <&clk 102>, <&clk 103>,
                     <&clk 99>, <&clk 128>, <&clk 129>, <&clk 130>,
                     <&clk 131>, <&clk 132>, <&clk 105>, <&clk 134>,
                     <&clk 111>, <&clk 106>, <&clk 109>;
            clock-names = "vip-sys0", "vip-sys1", "vip-sys2", "vip-sys3",
                          "axi", "cfg-reg", "vip-ip0", "vip-ip1",
                          "vip-ip2", "vip-ip3", "csi-be", "raw",
                          "isp-top", "csi-mac0", "csi0-rx";
            resets = <&rst RST_CSI_PHY0>, <&rst RST_CSI_PHY0_APB>;
            reset-names = "csi-phy", "csi-phy-apb";
            sophgo,ddr-top = <&ddr_top>;

            port {
                csi_in: endpoint {
                    remote-endpoint = <&camera_out>;
                    bus-type = <4>;
                    clock-lanes = <2>;
                    data-lanes = <4 3 1 0>;
                };
            };
        };

        camera@0 {
            compatible = "v4l2-clockless-camera";
            reg = <0 0>;

            port {
                camera_out: endpoint {
                    remote-endpoint = <&csi_in>;
                    bus-type = <4>;
                    clock-lanes = <2>;
                    data-lanes = <4 3 1 0>;
                };
            };
        };
    };
```

## Documentation/devicetree/bindings/media/sophgo,sg2002-vpss.yaml
```yaml
# SPDX-License-Identifier: (GPL-2.0-only OR BSD-2-Clause)
%YAML 1.2
---
$id: http://devicetree.org/schemas/media/sophgo,sg2002-vpss.yaml#
$schema: http://devicetree.org/meta-schemas/core.yaml#

title: Sophgo SG2002 VPSS scaler/CSC

maintainers:
  - George Whewell <georgerw@gmail.com>

description:
  The SG2002/CV181x video subsystem contains a scaler/CSC block ("VPSS")
  with two DRAM input DMA engines and four scaler cores, each with an
  output CSC and output DMA. This binding covers the memory-to-memory
  use of the IMG_IN_V engine with the SC_V1 scaler core.

properties:
  compatible:
    const: sophgo,sg2002-vpss

  reg:
    maxItems: 1

  interrupts:
    maxItems: 1

  clocks:
    items:
      - description: VIP sys 0 mux
      - description: VIP sys 1 mux
      - description: VIP sys 2 mux
      - description: IMG_IN_V gate
      - description: SC_TOP gate
      - description: SC_V1 gate

  clock-names:
    items:
      - const: sys0
      - const: sys1
      - const: sys2
      - const: img_v
      - const: sc_top
      - const: sc_v1

  memory-region:
    maxItems: 1

required:
  - compatible
  - reg
  - interrupts
  - clocks
  - clock-names

additionalProperties: false

examples:
  - |
    #include <dt-bindings/clock/sophgo,cv1800.h>
    #include <dt-bindings/interrupt-controller/irq.h>

    vpss@a080000 {
        compatible = "sophgo,sg2002-vpss";
        reg = <0x0a080000 0x10000>;
        interrupts = <25 IRQ_TYPE_LEVEL_HIGH>;
        clocks = <&clk CLK_SRC_VIP_SYS_0>, <&clk CLK_SRC_VIP_SYS_1>,
                 <&clk CLK_SRC_VIP_SYS_2>, <&clk CLK_IMG_V_VIP>,
                 <&clk CLK_SC_TOP_VIP>, <&clk CLK_SC_V1_VIP>;
        clock-names = "sys0", "sys1", "sys2", "img_v", "sc_top", "sc_v1";
    };
```

## Documentation/devicetree/bindings/nvmem/sophgo,sg2002-efuse.yaml
```yaml
# SPDX-License-Identifier: (GPL-2.0-only OR BSD-2-Clause)
%YAML 1.2
---
$id: http://devicetree.org/schemas/nvmem/sophgo,sg2002-efuse.yaml#
$schema: http://devicetree.org/meta-schemas/core.yaml#

title: Sophgo SG2002 eFuse

maintainers:
  - George Whewell <georgerw@gmail.com>

description: |
  The controller provides a 256-byte logical shadow aperture at offset 0x100.
  The eight-byte factory UID occupies shadow offsets 0x0c..0x13. The ten
  public user words occupy offsets 0x40, 0x48, ..., 0x88 within that
  aperture. The eight-byte device ID starts at shadow offset 0x8c. These
  offsets are relative to the shadow aperture, not to the controller base.
  The device ID is not specified to be a unique serial number.

allOf:
  - $ref: nvmem.yaml#

properties:
  compatible:
    const: sophgo,sg2002-efuse

  reg:
    maxItems: 1

  clocks:
    maxItems: 2

  clock-names:
    items:
      - const: efuse
      - const: apb

required:
  - compatible
  - reg
  - clocks
  - clock-names

unevaluatedProperties: false

examples:
  - |
    #include <dt-bindings/clock/sophgo,cv1800.h>

    efuse@3050000 {
        compatible = "sophgo,sg2002-efuse";
        reg = <0x03050000 0x1000>;
        clocks = <&clk CLK_EFUSE>, <&clk CLK_APB_EFUSE>;
        clock-names = "efuse", "apb";

        nvmem-layout {
            compatible = "fixed-layout";
            #address-cells = <1>;
            #size-cells = <1>;

            uid@c {
                reg = <0x0c 0x8>;
            };
        };
    };
```

## Documentation/devicetree/bindings/rng/sophgo,sg2002-trng.yaml
```yaml
# SPDX-License-Identifier: (GPL-2.0-only OR BSD-2-Clause)
%YAML 1.2
---
$id: http://devicetree.org/schemas/rng/sophgo,sg2002-trng.yaml#
$schema: http://devicetree.org/meta-schemas/core.yaml#

title: Sophgo SG2002 random number generator

maintainers:
  - George Whewell <georgerw@gmail.com>

description: |
  The SG2002 security subsystem contains a DesignWare NIST random number
  generator. Its register interface shares the eFuse clocks.

properties:
  compatible:
    const: sophgo,sg2002-trng

  reg:
    maxItems: 1

  clocks:
    maxItems: 2

  clock-names:
    items:
      - const: core
      - const: apb

required:
  - compatible
  - reg
  - clocks
  - clock-names

additionalProperties: false

examples:
  - |
    #include <dt-bindings/clock/sophgo,sg2002-clk.h>

    rng@2070000 {
        compatible = "sophgo,sg2002-trng";
        reg = <0x02070000 0x1000>;
        clocks = <&clk CLK_EFUSE>, <&clk CLK_APB_EFUSE>;
        clock-names = "core", "apb";
    };
```

## drivers/media/platform/chips-media/Kconfig
```kconfig
# SPDX-License-Identifier: GPL-2.0-only

comment "Chips&Media media platform drivers"

source "drivers/media/platform/chips-media/sg2002-vc-sram/Kconfig"
source "drivers/media/platform/chips-media/coda/Kconfig"
source "drivers/media/platform/chips-media/wave5/Kconfig"
source "drivers/media/platform/chips-media/wave420l/Kconfig"
source "drivers/media/platform/chips-media/sg2002-jpeg/Kconfig"
```

## drivers/media/platform/chips-media/sg2002-jpeg/Kconfig
```kconfig
# SPDX-License-Identifier: GPL-2.0-only
config VIDEO_SG2002_JPEG
	tristate "Sophgo SG2002 JPEG encoder"
	depends on V4L_MEM2MEM_DRIVERS
	depends on VIDEO_DEV && OF && HAS_DMA
	depends on ARCH_SOPHGO || COMPILE_TEST
	select V4L2_MEM2MEM_DEV
	select VIDEOBUF2_DMA_CONTIG
	help
	  A V4L2 mem2mem driver for the Chips&Media JPEG unit of the
	  Sophgo SG2002. It encodes NV12 and NV21 frames to baseline
	  JPEG.

	  To compile this driver as a module, choose M here: the module
	  will be called sg2002-jpeg.
```

## drivers/media/platform/chips-media/sg2002-vc-sram/Kconfig
```kconfig
# SPDX-License-Identifier: GPL-2.0-only
config VIDEO_SG2002_VC_SRAM
	tristate
	help
	  The arbiter for the codec SRAM of the Sophgo SG2002, which the
	  Coda980 (H.264) and WAVE420L (H.265) drivers take in turns. It is
	  selected by the drivers that need it.
```
